## drivers/input/touchscreen/focaltech_touch_mi/Kconfig
```kconfig
#
# Focaltech Touchscreen driver configuration
#

config TOUCHSCREEN_FTS_MI
	tristate "Focaltech Touchscreen"
	depends on I2C
	default n
	select TOUCHSCREEN_COMMON
	help
	  Say Y here if you have Focaltech touch panel.
	  If unsure, say N.

	  To compile this driver as a module, choose M here: the
          module will be called focaltech_fts_mi

config TOUCHSCREEN_FTS_FOD
	bool "Focaltech Touchscreen Fod func"
	depends on TOUCHSCREEN_FTS_MI
	default n
	help
	  Say Y here if you support fod function.
	  If unsure, say N.
```
